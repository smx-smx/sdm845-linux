// SPDX-License-Identifier: GPL-2.0
/*
 * SDM845 OnePlus 6 (enchilada) specific device tree
 *
 * Copyright (c) 2020, The Linux Foundation. All rights reserved.
 */

#include "sdm845-oneplus-common.dtsi"

/ {
	model = "OnePlus 6";
	compatible = "oneplus,enchilada", "oneplus,oneplus6", "qcom,sdm845";
};

&display_panel {
	compatible = "samsung,sofef00";
	status = "okay";
};
