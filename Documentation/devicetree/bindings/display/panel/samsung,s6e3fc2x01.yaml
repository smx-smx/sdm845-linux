## Documentation/devicetree/bindings/display/panel/samsung,s6e3fc2x01.yaml
```yaml
# SPDX-License-Identifier: GPL-2.0-only
%YAML 1.2
---
$id: http://devicetree.org/schemas/display/panel/samsung,s6e3fc2x01.yaml#
$schema: http://devicetree.org/meta-schemas/core.yaml#

title: Samsung s6e3fc2x01 AMOLED LCD panel

maintainers:
  - Caleb Connolly <caleb@connolly.tech>

allOf:
  - $ref: panel-common.yaml#

properties:
  compatible:
    # 1080x2340 AMOLED panel
    const: samsung,s6e3fc2x01

  reg: true
  reset-gpios: true
  port: true

  vddio-supply:
    description: VDD regulator

required:
  - compatible
  - reset-gpios
  - vddio-supply
  - port

unevaluatedProperties: false

examples:
  - |
    dsi0 {
      status = "okay";
      vdda-supply = <&vdda_mipi_dsi0_1p2>;
      #address-cells = <1>;
      #size-cells = <0>;

      display_panel: panel@0 {
        compatible = "samsung,s6e3fc2x01"
        #address-cells = <1>;
        #size-cells = <0>;
        reg = <0>;

        vddio-supply = <&vreg_l14a_1p88>;

        reset-gpios = <&tlmm 6 GPIO_ACTIVE_HIGH>;

        pinctrl-names = "default";
        pinctrl-0 = <&panel_reset_pins>;

        port {
          panel_in: endpoint {
            remote-endpoint = <&dsi0_out>;
          };
        };
      };
    };

...
```

## Documentation/devicetree/bindings/extcon/extcon-usbc-cros-ec.yaml
```yaml
# SPDX-License-Identifier: (GPL-2.0-only OR BSD-2-Clause)
%YAML 1.2
---
$id: https://protect2.fireeye.com/url?k=d3c63a24-8e5dc647-d3c7b16b-0cc47a31cdbc-e8d8e2b7806aed8e&u=http://devicetree.org/schemas/extcon/extcon-usbc-cros-ec.yaml#
$schema: https://protect2.fireeye.com/url?k=04f78247-596c7e24-04f60908-0cc47a31cdbc-1b9a3937c161a4b6&u=http://devicetree.org/meta-schemas/core.yaml#

title: ChromeOS EC USB Type-C cable and accessories detection

maintainers:
  - Benson Leung <bleung@chromium.org>
  - Enric Balletbo i Serra <enric.balletbo@collabora.com>

description: |
  On ChromeOS systems with USB Type C ports, the ChromeOS Embedded Controller is
  able to detect the state of external accessories such as display adapters
  or USB devices when said accessories are attached or detached.
  The node for this device must be under a cros-ec node like google,cros-ec-spi
  or google,cros-ec-i2c.

properties:
  compatible:
    const: google,extcon-usbc-cros-ec

  google,usb-port-id:
    allOf:
      - $ref: /schemas/types.yaml#/definitions/uint32
    description: the port id
    minimum: 0
    maximum: 255

required:
  - compatible
  - google,usb-port-id

additionalProperties: false

examples:
  - |
    spi0 {
        #address-cells = <1>;
        #size-cells = <0>;
        cros-ec@0 {
            compatible = "google,cros-ec-spi";
            reg = <0>;

            usbc_extcon0: extcon0 {
                compatible = "google,extcon-usbc-cros-ec";
                google,usb-port-id = <0>;
            };

            usbc_extcon1: extcon1 {
                compatible = "google,extcon-usbc-cros-ec";
                google,usb-port-id = <1>;
            };
        };
    };
```

## Documentation/devicetree/bindings/timer/ingenic,tcu.yaml
```yaml
# SPDX-License-Identifier: (GPL-2.0-only OR BSD-2-Clause)
%YAML 1.2
---
$id: http://devicetree.org/schemas/timer/ingenic,tcu.yaml#
$schema: http://devicetree.org/meta-schemas/core.yaml#

title: Ingenic SoCs Timer/Counter Unit (TCU) devicetree bindings

description: |
  For a description of the TCU hardware and drivers, have a look at
  Documentation/mips/ingenic-tcu.rst.

maintainers:
  - Paul Cercueil <paul@crapouillou.net>

properties:
  $nodename:
    pattern: "^timer@.*"

  "#address-cells":
    const: 1

  "#size-cells":
    const: 1

  "#clock-cells":
    const: 1

  "#interrupt-cells":
    const: 1

  interrupt-controller: true

  ranges: true

  compatible:
    items:
      - enum:
        - ingenic,jz4740-tcu
        - ingenic,jz4725b-tcu
        - ingenic,jz4770-tcu
        - ingenic,x1000-tcu
      - const: simple-mfd

  reg:
    maxItems: 1

  clocks:
    items:
      - description: RTC clock
      - description: EXT clock
      - description: PCLK clock
      - description: TCU clock
    minItems: 3

  clock-names:
    items:
      - const: rtc
      - const: ext
      - const: pclk
      - const: tcu
    minItems: 3

  interrupts:
    minItems: 1
    maxItems: 3

  ingenic,pwm-channels-mask:
    description: Bitmask of TCU channels reserved for PWM use.
    allOf:
      - $ref: /schemas/types.yaml#/definitions/uint32
      - minimum: 0x00
      - maximum: 0xff
      - default: 0xfc

patternProperties:
  "^watchdog@[a-f0-9]+$":
    type: object
    allOf: [ $ref: ../watchdog/watchdog.yaml# ]
    properties:
      compatible:
        oneOf:
          - enum:
            - ingenic,jz4740-watchdog
            - ingenic,jz4780-watchdog
          - items:
            - const: ingenic,jz4770-watchdog
            - const: ingenic,jz4740-watchdog

      clocks:
        maxItems: 1

      clock-names:
        const: wdt

    required:
      - compatible
      - clocks
      - clock-names

  "^pwm@[a-f0-9]+$":
    type: object
    allOf: [ $ref: ../pwm/pwm.yaml# ]
    properties:
      compatible:
        oneOf:
          - enum:
            - ingenic,jz4740-pwm
          - items:
            - enum:
              - ingenic,jz4770-pwm
              - ingenic,jz4780-pwm
            - const: ingenic,jz4740-pwm

      clocks:
        minItems: 6
        maxItems: 8

      clock-names:
        items:
          - const: timer0
          - const: timer1
          - const: timer2
          - const: timer3
          - const: timer4
          - const: timer5
          - const: timer6
          - const: timer7
        minItems: 6

    required:
      - compatible
      - clocks
      - clock-names

  "^timer@[a-f0-9]+":
    type: object
    properties:
      compatible:
        oneOf:
          - enum:
            - ingenic,jz4725b-ost
            - ingenic,jz4770-ost
          - items:
            - const: ingenic,jz4780-ost
            - const: ingenic,jz4770-ost


      clocks:
        maxItems: 1

      clock-names:
        const: ost

      interrupts:
        maxItems: 1

    required:
      - compatible
      - clocks
      - clock-names
      - interrupts

required:
  - "#clock-cells"
  - "#interrupt-cells"
  - interrupt-controller
  - compatible
  - reg
  - clocks
  - clock-names
  - interrupts

additionalProperties: false

examples:
  - |
    #include <dt-bindings/clock/jz4770-cgu.h>
    #include <dt-bindings/clock/ingenic,tcu.h>
    tcu: timer@10002000 {
      compatible = "ingenic,jz4770-tcu", "simple-mfd";
      reg = <0x10002000 0x1000>;
      #address-cells = <1>;
      #size-cells = <1>;
      ranges = <0x0 0x10002000 0x1000>;

      #clock-cells = <1>;

      clocks = <&cgu JZ4770_CLK_RTC>,
               <&cgu JZ4770_CLK_EXT>,
               <&cgu JZ4770_CLK_PCLK>;
      clock-names = "rtc", "ext", "pclk";

      interrupt-controller;
      #interrupt-cells = <1>;

      interrupt-parent = <&intc>;
      interrupts = <27 26 25>;

      watchdog: watchdog@0 {
        compatible = "ingenic,jz4770-watchdog", "ingenic,jz4740-watchdog";
        reg = <0x0 0xc>;

        clocks = <&tcu TCU_CLK_WDT>;
        clock-names = "wdt";
      };

      pwm: pwm@40 {
        compatible = "ingenic,jz4770-pwm", "ingenic,jz4740-pwm";
        reg = <0x40 0x80>;

        #pwm-cells = <3>;

        clocks = <&tcu TCU_CLK_TIMER0>,
                 <&tcu TCU_CLK_TIMER1>,
                 <&tcu TCU_CLK_TIMER2>,
                 <&tcu TCU_CLK_TIMER3>,
                 <&tcu TCU_CLK_TIMER4>,
                 <&tcu TCU_CLK_TIMER5>,
                 <&tcu TCU_CLK_TIMER6>,
                 <&tcu TCU_CLK_TIMER7>;
        clock-names = "timer0", "timer1", "timer2", "timer3",
                "timer4", "timer5", "timer6", "timer7";
      };

      ost: timer@e0 {
        compatible = "ingenic,jz4770-ost";
        reg = <0xe0 0x20>;

        clocks = <&tcu TCU_CLK_OST>;
        clock-names = "ost";

        interrupts = <15>;
      };
    };
```
